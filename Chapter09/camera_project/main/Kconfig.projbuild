## Chapter09/camera_project/main/Kconfig.projbuild
```kconfig
menu "Example Connection"

config EXAMPLE_WIFI_SSID
    string "WiFi SSID"
    default "YOUR_WIFI_SSID"

config EXAMPLE_WIFI_PASSWORD
    string "WiFi Password"
    default "YOUR_WIFI_PASSWORD"

endmenu
```
